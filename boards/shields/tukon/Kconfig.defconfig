## boards/shields/tukon/Kconfig.defconfig
```kconfig
# This file sets the the board specific configuration
# see https://docs.zephyrproject.org/latest/build/kconfig/setting.html#initial-conf

if SHIELD_TUKON_LEFT

config ZMK_KEYBOARD_NAME
    default "Tukon"

config ZMK_SPLIT_ROLE_CENTRAL
    default y

endif # SHIELD_TUKON_LEFT

if SHIELD_TUKON_LEFT || SHIELD_TUKON_RIGHT

config ZMK_SPLIT
    default y

config TUKON_RGB_UNDERGLOW
    bool "Tukon per Key RGB LEDs"
    default n
    select ZMK_RGB_UNDERGLOW

config ZMK_EXT_POWER
    default ZMK_RGB_UNDERGLOW

if ZMK_RGB_UNDERGLOW

config ZMK_RGB_UNDERGLOW_AUTO_OFF_IDLE
    default y

config ZMK_RGB_UNDERGLOW_AUTO_OFF_USB
    default y if USB_DEVICE_STACK

config ZMK_RGB_UNDERGLOW_BRT_START
    default 10

endif # ZMK_RGB_UNDERGLOW

config TUKON_DISPLAY
    bool "Tukon OLED Display"
    default y
    select ZMK_DISPLAY
    select REGULATOR

if ZMK_DISPLAY

config I2C
    default y

config SSD1306
    default y

config ZMK_WIDGET_BATTERY_STATUS_SHOW_PERCENTAGE
    default n

config ZMK_WIDGET_WPM_STATUS
    default y if ZMK_SPLIT_ROLE_CENTRAL

endif # ZMK_DISPLAY


if LVGL

config LV_Z_VDB_SIZE
    default 64

config LV_DPI_DEF
    default 148

config LV_Z_BITS_PER_PIXEL
    default 1

choice LV_COLOR_DEPTH
    default LV_COLOR_DEPTH_1
endchoice

endif # LVGL

    
endif # SHIELD_TUKON_LEFT || SHIELD_TUKON_RIGHT
```
